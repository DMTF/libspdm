## CMakeLists.txt
```
cmake_minimum_required(VERSION 3.20.0)

find_package(Zephyr REQUIRED HINTS $ENV{ZEPHYR_BASE})
project(spdm_loopback)

target_sources(app PRIVATE
  src/main.c
  src/mock_transport.c
  src/requester.c
  src/responder.c
  ${CMAKE_CURRENT_LIST_DIR}/../common/sample_ecp256.c
  ${CMAKE_CURRENT_LIST_DIR}/../common/sample_static_blob_store.c
  ${CMAKE_CURRENT_LIST_DIR}/../common/sample_support.c
  ${CMAKE_CURRENT_LIST_DIR}/../common/sample_set_cert.c
)
target_include_directories(app PRIVATE ${CMAKE_CURRENT_LIST_DIR}/../common)
```

## sample.yaml
```
sample:
  description: libspdm requester/responder loopback inside a single Zephyr node
  name: libspdm loopback
tests:
  sample.lib.libspdm.loopback:
    tags: libspdm
    integration_platforms:
      - qemu_x86_64
      - mps2/an521/cpu0
    platform_allow:
      - qemu_x86_64
      - mps2/an521/cpu0
    harness: console
    harness_config:
      type: one_line
      regex:
        - "SPDM session ping/pong PASSED"
```

## prj.conf
```kconfig
# libspdm
CONFIG_LIBSPDM=y
CONFIG_LIBSPDM_REQUESTER=y
CONFIG_LIBSPDM_RESPONDER=y
CONFIG_LIBSPDM_CRYPTO_MBEDTLS=y
CONFIG_LIBSPDM_TRANSPORT_MCTP=y
CONFIG_LIBSPDM_DEBUG_ENABLE=y
CONFIG_LIBSPDM_SECRET_LIB_SAMPLE=y

# Ensure enough memory is available
CONFIG_MAIN_STACK_SIZE=8192
CONFIG_HEAP_MEM_POOL_SIZE=131072
CONFIG_COMMON_LIBC_MALLOC=y
CONFIG_COMMON_LIBC_MALLOC_ARENA_SIZE=131072

# libspdm prints a very verbose log. If you want to see it, remove
# the following two lines.
CONFIG_LOG=n
CONFIG_LIBSPDM_DEBUG_ENABLE=n
```

## src/main.c
```c
/**
 *  Copyright Notice:
 *  Copyright 2026 DMTF. All rights reserved.
 *  License: BSD 3-Clause License. For full text see link: https://github.com/DMTF/libspdm/blob/main/LICENSE.md
 **/

#include <zephyr/kernel.h>
#include <zephyr/sys/printk.h>

#include "spdm_loopback.h"
#include "sample_ecp256.h"
#include "sample_static_blob_store.h"
#include "sample_support.h"

/* The two channels making up the loopback link. */
static struct mock_channel req_to_rsp;
static struct mock_channel rsp_to_req;

static struct mock_transport requester_transport;
static struct mock_transport responder_transport;

K_SEM_DEFINE(responder_ready, 0, 1);

#define STACK_SIZE 16384

K_THREAD_STACK_DEFINE(responder_stack, STACK_SIZE);
K_THREAD_STACK_DEFINE(requester_stack, STACK_SIZE);
static struct k_thread responder_thread;
static struct k_thread requester_thread;

int main(void)
{
    printk("\nlibspdm Zephyr loopback demo\n");
    printk("============================\n");

    if (sample_static_blob_register(sample_ecp256_blobs) != 0) {
        printk("secret blob registration failed\n");
        return -1;
    }

    /* X.509 validity checks need a wall clock. Point it at a time
     * inside the sample certificates' window. */
    sample_wallclock_init(SAMPLE_ECP256_WALLCLOCK_S);

    mock_channel_init(&req_to_rsp);
    mock_channel_init(&rsp_to_req);

    requester_transport.tx = &req_to_rsp;
    requester_transport.rx = &rsp_to_req;
    responder_transport.tx = &rsp_to_req;
    responder_transport.rx = &req_to_rsp;

    k_thread_create(&responder_thread, responder_stack, STACK_SIZE,
                    responder_thread_main, &responder_transport, NULL, NULL,
                    K_PRIO_PREEMPT(7), 0, K_NO_WAIT);
    k_thread_name_set(&responder_thread, "spdm_rsp");

    k_thread_create(&requester_thread, requester_stack, STACK_SIZE,
                    requester_thread_main, &requester_transport, NULL, NULL,
                    K_PRIO_PREEMPT(7), 0, K_NO_WAIT);
    k_thread_name_set(&requester_thread, "spdm_req");

    /* Wait for the requester to finish, then tell the responder that
     * the link is gone so it winds down immediately instead of sitting
     * out its receive timeout. */
    k_thread_join(&requester_thread, K_SECONDS(60));
    mock_channel_close(&req_to_rsp);
    k_thread_join(&responder_thread, K_SECONDS(5));
    printk("\nlibspdm Zephyr loopback demo: main exiting\n");
    return 0;
}
```

## src/mock_transport.c
```c
/**
 *  Copyright Notice:
 *  Copyright 2026 DMTF. All rights reserved.
 *  License: BSD 3-Clause License. For full text see link: https://github.com/DMTF/libspdm/blob/main/LICENSE.md
 **/

/*
 * In-process loopback transport for the demo.
 *
 * The libspdm device_send / device_receive callbacks below receive
 * already-framed transport bytes (MCTP + SPDM) and shuttle them
 * across two synchronised buffers - no real wire involved.
 */

#include <errno.h>
#include <string.h>

#include <zephyr/kernel.h>
#include <zephyr/sys/printk.h>

#include "library/spdm_common_lib.h"
#include "library/spdm_transport_mctp_lib.h"

#include "spdm_loopback.h"

#define MOCK_TIMEOUT_MS 60000

/*
 * Per-context state.
 *
 * libspdm has no generic "opaque per-context pointer" data key, so a
 * small static table keyed on the spdm_context pointer stands in for
 * one.
 */
struct loopback_endpoint {
    void *spdm_context;
    struct mock_transport *chan;   /* this side's tx/rx channel pair */

    uint8_t msg_buf[SPDM_LOOPBACK_BUFFER_SIZE];
    bool msg_buf_in_use;
};

#define LOOPBACK_MAX_ENDPOINTS 4
static struct loopback_endpoint endpoints[LOOPBACK_MAX_ENDPOINTS];
static struct k_spinlock endpoints_lock;

void mock_channel_init(struct mock_channel *ch)
{
    ch->len = 0;
    ch->closed = false;
    k_sem_init(&ch->ready, 0, 1);
    k_sem_init(&ch->freed, 1, 1);  /* slot starts empty */
}

void mock_channel_close(struct mock_channel *ch)
{
    ch->closed = true;
    k_sem_give(&ch->ready);
}

/* Claim a table entry for @spdm_context. Called once per context from
 * mock_transport_install(), before that context is handed to libspdm,
 * so the table is fully populated before any callback can run. */
static struct loopback_endpoint *endpoint_bind(void *spdm_context,
                                               struct mock_transport *chan)
{
    k_spinlock_key_t key = k_spin_lock(&endpoints_lock);

    for (int i = 0; i < LOOPBACK_MAX_ENDPOINTS; i++) {
        if (endpoints[i].spdm_context == NULL) {
            endpoints[i].spdm_context = spdm_context;
            endpoints[i].chan = chan;
            endpoints[i].msg_buf_in_use = false;
            k_spin_unlock(&endpoints_lock, key);
            return &endpoints[i];
        }
    }

    k_spin_unlock(&endpoints_lock, key);
    printk("mock_transport: endpoint table full\n");
    return NULL;
}

/* Entries are never reassigned after endpoint_bind(), so no lock is
 * needed on this path even though the two roles run on separate threads. */
static struct loopback_endpoint *endpoint_find(void *spdm_context)
{
    for (int i = 0; i < LOOPBACK_MAX_ENDPOINTS; i++) {
        if (endpoints[i].spdm_context == spdm_context) {
            return &endpoints[i];
        }
    }
    return NULL;
}

static struct mock_transport *mock_transport_get(void *spdm_context)
{
    struct loopback_endpoint *ep = endpoint_find(spdm_context);

    return (ep != NULL) ? ep->chan : NULL;
}

static libspdm_return_t mock_send_message(void *spdm_context,
                                          size_t message_size,
                                          const void *message,
                                          uint64_t timeout)
{
    struct mock_transport *t = mock_transport_get(spdm_context);

    if (t == NULL || t->tx == NULL) {
        return LIBSPDM_STATUS_SEND_FAIL;
    }
    if (message_size > sizeof(t->tx->buf)) {
        printk("mock_send: msg %zu > buf %zu\n", message_size,
               sizeof(t->tx->buf));
        return LIBSPDM_STATUS_SEND_FAIL;
    }

    /* Wait for the slot to be drained by the peer. */
    if (k_sem_take(&t->tx->freed, K_MSEC(MOCK_TIMEOUT_MS)) != 0) {
        return LIBSPDM_STATUS_SEND_FAIL;
    }
    memcpy(t->tx->buf, message, message_size);
    t->tx->len = message_size;
    k_sem_give(&t->tx->ready);
    return LIBSPDM_STATUS_SUCCESS;
}

static libspdm_return_t mock_receive_message(void *spdm_context,
                                             size_t *message_size,
                                             void **message,
                                             uint64_t timeout)
{
    struct mock_transport *t = mock_transport_get(spdm_context);

    if (t == NULL || t->rx == NULL) {
        return LIBSPDM_STATUS_RECEIVE_FAIL;
    }

    if (k_sem_take(&t->rx->ready, K_MSEC(MOCK_TIMEOUT_MS)) != 0) {
        return LIBSPDM_STATUS_RECEIVE_FAIL;
    }
    if (t->rx->closed) {
        return LIBSPDM_STATUS_RECEIVE_FAIL;
    }
    if (t->rx->len > *message_size) {
        printk("mock_recv: msg %zu > caller buf %zu\n", t->rx->len,
               *message_size);
        k_sem_give(&t->rx->freed);
        return LIBSPDM_STATUS_RECEIVE_FAIL;
    }
    memcpy(*message, t->rx->buf, t->rx->len);
    *message_size = t->rx->len;
    t->rx->len = 0;
    k_sem_give(&t->rx->freed);
    return LIBSPDM_STATUS_SUCCESS;
}

static libspdm_return_t acquire_sender_buffer(void *spdm_context,
                                              void **msg_buf_ptr)
{
    struct loopback_endpoint *ep = endpoint_find(spdm_context);

    if (ep == NULL || ep->msg_buf_in_use) {
        return LIBSPDM_STATUS_ACQUIRE_FAIL;
    }
    ep->msg_buf_in_use = true;
    memset(ep->msg_buf, 0, sizeof(ep->msg_buf));
    *msg_buf_ptr = ep->msg_buf;
    return LIBSPDM_STATUS_SUCCESS;
}

static void release_sender_buffer(void *spdm_context, const void *msg_buf_ptr)
{
    struct loopback_endpoint *ep = endpoint_find(spdm_context);

    ARG_UNUSED(msg_buf_ptr);
    if (ep != NULL) {
        ep->msg_buf_in_use = false;
    }
}

static libspdm_return_t acquire_receiver_buffer(void *spdm_context,
                                                void **msg_buf_ptr)
{
    return acquire_sender_buffer(spdm_context, msg_buf_ptr);
}

static void release_receiver_buffer(void *spdm_context, const void *msg_buf_ptr)
{
    release_sender_buffer(spdm_context, msg_buf_ptr);
}

void mock_transport_install(void *spdm_context, struct mock_transport *t)
{
    if (endpoint_bind(spdm_context, t) == NULL) {
        return;
    }

    libspdm_register_device_io_func(spdm_context,
                                    mock_send_message,
                                    mock_receive_message);

    libspdm_register_transport_layer_func(
        spdm_context,
        SPDM_LOOPBACK_BUFFER_SIZE - SPDM_LOOPBACK_TRANSPORT_ADDITIONAL,
        SPDM_LOOPBACK_TRANSPORT_HEADER_SIZE,
        SPDM_LOOPBACK_TRANSPORT_TAIL_SIZE,
        libspdm_transport_mctp_encode_message,
        libspdm_transport_mctp_decode_message);

    libspdm_register_device_buffer_func(spdm_context,
                                        SPDM_LOOPBACK_BUFFER_SIZE,
                                        SPDM_LOOPBACK_BUFFER_SIZE,
                                        acquire_sender_buffer,
                                        release_sender_buffer,
                                        acquire_receiver_buffer,
                                        release_receiver_buffer);
}
```

## src/requester.c
```c
/**
 *  Copyright Notice:
 *  Copyright 2026 DMTF. All rights reserved.
 *  License: BSD 3-Clause License. For full text see link: https://github.com/DMTF/libspdm/blob/main/LICENSE.md
 **/

/*
 * SPDM requester thread for the libspdm Zephyr loopback demo.
 */

#include <stdlib.h>
#include <string.h>

#include <zephyr/kernel.h>
#include <zephyr/sys/printk.h>

#include "library/spdm_common_lib.h"
#include "library/spdm_requester_lib.h"
#include "internal/libspdm_device_secret_lib.h"
#include "hal/library/memlib.h"
#include "industry_standard/spdm.h"

#include "spdm_loopback.h"

void *requester_spdm_context;
void *requester_scratch;

static bool install_peer_root_cert(void *ctx)
{
    libspdm_data_parameter_t parameter;
    void *cert_chain = NULL;
    size_t cert_chain_size = 0;
    void *hash = NULL;
    size_t hash_size = 0;
    const uint8_t *root_cert;
    size_t root_cert_size;
    bool res;

    res = libspdm_read_responder_public_certificate_chain(
        SPDM_ALGORITHMS_BASE_HASH_ALGO_TPM_ALG_SHA_256,
        SPDM_ALGORITHMS_BASE_ASYM_ALGO_TPM_ALG_ECDSA_ECC_NIST_P256,
        &cert_chain, &cert_chain_size, &hash, &hash_size);
    if (!res || cert_chain == NULL) {
        printk("[requester] cannot load responder cert chain "
               "(needed only to extract root cert)\n");
        return false;
    }

    res = libspdm_x509_get_cert_from_cert_chain(
        (uint8_t *)cert_chain + sizeof(spdm_cert_chain_t) + hash_size,
        cert_chain_size - sizeof(spdm_cert_chain_t) - hash_size,
        0, &root_cert, &root_cert_size);
    if (!res) {
        printk("[requester] cert-chain root extract failed\n");
        free(cert_chain);
        return false;
    }

    libspdm_zero_mem(&parameter, sizeof(parameter));
    parameter.location = LIBSPDM_DATA_LOCATION_LOCAL;
    libspdm_set_data(ctx, LIBSPDM_DATA_PEER_PUBLIC_ROOT_CERT,
                     &parameter, (void *)root_cert, root_cert_size);
    return true;
}

static void configure_requester(void *ctx)
{
    libspdm_data_parameter_t parameter;
    uint8_t u8;
    uint16_t u16;
    uint32_t u32;
    spdm_version_number_t version;

    libspdm_zero_mem(&parameter, sizeof(parameter));
    parameter.location = LIBSPDM_DATA_LOCATION_LOCAL;

    version = SPDM_MESSAGE_VERSION_12 << SPDM_VERSION_NUMBER_SHIFT_BIT;
    libspdm_set_data(ctx, LIBSPDM_DATA_SPDM_VERSION, &parameter,
                     &version, sizeof(version));

    u8 = 0;
    libspdm_set_data(ctx, LIBSPDM_DATA_CAPABILITY_CT_EXPONENT, &parameter,
                     &u8, sizeof(u8));

    u32 = SPDM_GET_CAPABILITIES_REQUEST_FLAGS_CERT_CAP |
          SPDM_GET_CAPABILITIES_REQUEST_FLAGS_CHAL_CAP;
    libspdm_set_data(ctx, LIBSPDM_DATA_CAPABILITY_FLAGS, &parameter,
                     &u32, sizeof(u32));

    u8 = SPDM_MEASUREMENT_SPECIFICATION_DMTF;
    libspdm_set_data(ctx, LIBSPDM_DATA_MEASUREMENT_SPEC, &parameter,
                     &u8, sizeof(u8));
    u32 = SPDM_ALGORITHMS_BASE_ASYM_ALGO_TPM_ALG_ECDSA_ECC_NIST_P256;
    libspdm_set_data(ctx, LIBSPDM_DATA_BASE_ASYM_ALGO, &parameter,
                     &u32, sizeof(u32));
    u32 = SPDM_ALGORITHMS_BASE_HASH_ALGO_TPM_ALG_SHA_256;
    libspdm_set_data(ctx, LIBSPDM_DATA_BASE_HASH_ALGO, &parameter,
                     &u32, sizeof(u32));
    u16 = SPDM_ALGORITHMS_DHE_NAMED_GROUP_SECP_256_R1;
    libspdm_set_data(ctx, LIBSPDM_DATA_DHE_NAME_GROUP, &parameter,
                     &u16, sizeof(u16));
    u16 = SPDM_ALGORITHMS_AEAD_CIPHER_SUITE_AES_256_GCM;
    libspdm_set_data(ctx, LIBSPDM_DATA_AEAD_CIPHER_SUITE, &parameter,
                     &u16, sizeof(u16));
    u16 = SPDM_ALGORITHMS_BASE_ASYM_ALGO_TPM_ALG_ECDSA_ECC_NIST_P256;
    libspdm_set_data(ctx, LIBSPDM_DATA_REQ_BASE_ASYM_ALG, &parameter,
                     &u16, sizeof(u16));
    u16 = SPDM_ALGORITHMS_KEY_SCHEDULE_SPDM;
    libspdm_set_data(ctx, LIBSPDM_DATA_KEY_SCHEDULE, &parameter,
                     &u16, sizeof(u16));
    u8 = SPDM_ALGORITHMS_OPAQUE_DATA_FORMAT_1;
    libspdm_set_data(ctx, LIBSPDM_DATA_OTHER_PARAMS_SUPPORT, &parameter,
                     &u8, sizeof(u8));
}

void requester_thread_main(void *a, void *b, void *c)
{
    struct mock_transport *t = (struct mock_transport *)a;
    libspdm_return_t status;
    size_t scratch_size;

    ARG_UNUSED(b);
    ARG_UNUSED(c);

    if (k_sem_take(&responder_ready, SPDM_LOOPBACK_READY_TIMEOUT) != 0) {
        printk("[requester] responder did not come up, giving up\n");
        return;
    }
    printk("[requester] starting\n");

    requester_spdm_context = malloc(libspdm_get_context_size());
    if (requester_spdm_context == NULL) {
        printk("[requester] ctx alloc failed\n");
        return;
    }
    libspdm_init_context(requester_spdm_context);

    mock_transport_install(requester_spdm_context, t);
    configure_requester(requester_spdm_context);
    if (!install_peer_root_cert(requester_spdm_context)) {
        return;
    }

    scratch_size = libspdm_get_sizeof_required_scratch_buffer(
        requester_spdm_context);
    requester_scratch = malloc(scratch_size);
    if (requester_scratch == NULL) {
        printk("[requester] scratch alloc failed (%zu)\n", scratch_size);
        return;
    }
    libspdm_set_scratch_buffer(requester_spdm_context,
                               requester_scratch, scratch_size);

    printk("[requester] ready, scratch=%zu bytes\n", scratch_size);

    /* GET_VERSION only first -- this is the smallest amount of bytes
     * that exercises the loopback transport, the MCTP framing and
     * both libspdm state machines. */
    status = libspdm_init_connection(requester_spdm_context, true);
    if (LIBSPDM_STATUS_IS_ERROR(status)) {
        printk("[requester] GET_VERSION failed: 0x%x\n", status);
        return;
    }
    printk("[requester] GET_VERSION ok\n");

    /* Now run GET_CAPABILITIES + NEGOTIATE_ALGORITHMS. */
    status = libspdm_init_connection(requester_spdm_context, false);
    if (LIBSPDM_STATUS_IS_ERROR(status)) {
        printk("[requester] init_connection (caps+algs) failed: 0x%x\n",
               status);
        return;
    }
    printk("[requester] GET_CAPABILITIES + NEGOTIATE_ALGORITHMS ok\n");

    {
        uint8_t slot_mask = 0;
        uint8_t total_digest[LIBSPDM_MAX_HASH_SIZE * SPDM_MAX_SLOT_COUNT];

        status = libspdm_get_digest(requester_spdm_context, NULL,
                                    &slot_mask, total_digest);
        if (LIBSPDM_STATUS_IS_ERROR(status)) {
            printk("[requester] GET_DIGESTS failed: 0x%x\n", status);
            return;
        }
        printk("[requester] GET_DIGESTS ok, slot_mask=0x%02x\n", slot_mask);
    }

    {
        static uint8_t cert_buf[0x800];
        size_t cert_chain_size = sizeof(cert_buf);

        status = libspdm_get_certificate(requester_spdm_context, NULL,
                                         0, &cert_chain_size, cert_buf);
        if (LIBSPDM_STATUS_IS_ERROR(status)) {
            printk("[requester] GET_CERTIFICATE failed: 0x%x\n", status);
            return;
        }
        printk("[requester] GET_CERTIFICATE ok, chain_size=%zu\n",
               cert_chain_size);
    }

    {
        uint8_t slot_mask = 0;

        status = libspdm_challenge(requester_spdm_context, NULL, 0,
                                   SPDM_CHALLENGE_REQUEST_NO_MEASUREMENT_SUMMARY_HASH,
                                   NULL, &slot_mask);
        if (LIBSPDM_STATUS_IS_ERROR(status)) {
            printk("[requester] CHALLENGE_AUTH failed: 0x%x\n", status);
            return;
        }
        printk("[requester] CHALLENGE_AUTH ok\n");
    }

    printk("[requester] *** SPDM authenticated handshake PASSED ***\n");
}
```

## src/responder.c
```c
/**
 *  Copyright Notice:
 *  Copyright 2026 DMTF. All rights reserved.
 *  License: BSD 3-Clause License. For full text see link: https://github.com/DMTF/libspdm/blob/main/LICENSE.md
 **/

/*
 * SPDM responder thread for the libspdm Zephyr loopback demo.
 */

#include <stdlib.h>
#include <string.h>

#include <zephyr/kernel.h>
#include <zephyr/sys/printk.h>

#include "library/spdm_common_lib.h"
#include "library/spdm_responder_lib.h"
#include "internal/libspdm_device_secret_lib.h"
#include "hal/library/memlib.h"
#include "industry_standard/spdm.h"

#include "spdm_loopback.h"

/*
 * Application payload exchanged over the secured session. The requester
 * (requester.c) must agree on APP_REQUEST / APP_REPLY.
 */
#define APP_REQUEST "ping"
#define APP_REPLY   "pong"

/*
 * Application-message handler. libspdm calls this for every message
 * that arrives inside a secured session with is_app_message == true.
 * This sample implements a trivial request/reply protocol: it answers
 * the request "ping" with "pong".
 */
static libspdm_return_t app_message_handler(
    void *spdm_context, const uint32_t *session_id, bool is_app_message,
    size_t request_size, const void *request,
    size_t *response_size, void *response)
{
    (void)spdm_context;

    /* Only answer application messages inside a secured session; let
     * libspdm's default handler deal with everything else. */
    if (!is_app_message || session_id == NULL) {
        return LIBSPDM_STATUS_UNSUPPORTED_CAP;
    }

    if (request_size == sizeof(APP_REQUEST) - 1 &&
        memcmp(request, APP_REQUEST, request_size) == 0) {
        printk("[responder] received secured app request \"%s\", replying \"%s\"\n",
               APP_REQUEST, APP_REPLY);
        if (*response_size < sizeof(APP_REPLY) - 1) {
            return LIBSPDM_STATUS_BUFFER_TOO_SMALL;
        }
        memcpy(response, APP_REPLY, sizeof(APP_REPLY) - 1);
        *response_size = sizeof(APP_REPLY) - 1;
        return LIBSPDM_STATUS_SUCCESS;
    }

    return LIBSPDM_STATUS_UNSUPPORTED_CAP;
}

void *responder_spdm_context;
void *responder_scratch;

static bool install_responder_cert_chain(void *ctx)
{
    libspdm_data_parameter_t parameter;
    void *cert_chain = NULL;
    size_t cert_chain_size = 0;
    uint8_t u8;
    bool res;

    res = libspdm_read_responder_public_certificate_chain(
        SPDM_ALGORITHMS_BASE_HASH_ALGO_TPM_ALG_SHA_256,
        SPDM_ALGORITHMS_BASE_ASYM_ALGO_TPM_ALG_ECDSA_ECC_NIST_P256,
        &cert_chain, &cert_chain_size, NULL, NULL);
    if (!res || cert_chain == NULL) {
        printk("[responder] failed to load responder cert chain\n");
        return false;
    }

    libspdm_zero_mem(&parameter, sizeof(parameter));
    parameter.location = LIBSPDM_DATA_LOCATION_LOCAL;
    parameter.additional_data[0] = 0; /* slot 0 */
    libspdm_set_data(ctx, LIBSPDM_DATA_LOCAL_PUBLIC_CERT_CHAIN,
                     &parameter, cert_chain, cert_chain_size);

    u8 = 1 << 0; /* only slot 0 populated */
    libspdm_set_data(ctx, LIBSPDM_DATA_LOCAL_SUPPORTED_SLOT_MASK,
                     &parameter, &u8, sizeof(u8));
    return true;
}

static void configure_responder(void *ctx)
{
    libspdm_data_parameter_t parameter;
    uint8_t u8;
    uint16_t u16;
    uint32_t u32;
    spdm_version_number_t version;

    libspdm_zero_mem(&parameter, sizeof(parameter));
    parameter.location = LIBSPDM_DATA_LOCATION_LOCAL;

    version = SPDM_MESSAGE_VERSION_12 << SPDM_VERSION_NUMBER_SHIFT_BIT;
    libspdm_set_data(ctx, LIBSPDM_DATA_SPDM_VERSION, &parameter,
                     &version, sizeof(version));

    u8 = 0;
    libspdm_set_data(ctx, LIBSPDM_DATA_CAPABILITY_CT_EXPONENT, &parameter,
                     &u8, sizeof(u8));

    u32 = SPDM_GET_CAPABILITIES_RESPONSE_FLAGS_CERT_CAP |
          SPDM_GET_CAPABILITIES_RESPONSE_FLAGS_CHAL_CAP |
          SPDM_GET_CAPABILITIES_RESPONSE_FLAGS_KEY_EX_CAP |
          SPDM_GET_CAPABILITIES_RESPONSE_FLAGS_ENCRYPT_CAP |
          SPDM_GET_CAPABILITIES_RESPONSE_FLAGS_MAC_CAP |
          SPDM_GET_CAPABILITIES_RESPONSE_FLAGS_HBEAT_CAP;
    libspdm_set_data(ctx, LIBSPDM_DATA_CAPABILITY_FLAGS, &parameter,
                     &u32, sizeof(u32));

    /* Algorithms to advertise. Match what the requester proposes. */
    u8 = 0;
    libspdm_set_data(ctx, LIBSPDM_DATA_MEASUREMENT_SPEC, &parameter,
                     &u8, sizeof(u8));
    u32 = SPDM_ALGORITHMS_BASE_ASYM_ALGO_TPM_ALG_ECDSA_ECC_NIST_P256;
    libspdm_set_data(ctx, LIBSPDM_DATA_BASE_ASYM_ALGO, &parameter,
                     &u32, sizeof(u32));
    u32 = SPDM_ALGORITHMS_BASE_HASH_ALGO_TPM_ALG_SHA_256;
    libspdm_set_data(ctx, LIBSPDM_DATA_BASE_HASH_ALGO, &parameter,
                     &u32, sizeof(u32));
    u16 = SPDM_ALGORITHMS_DHE_NAMED_GROUP_SECP_256_R1;
    libspdm_set_data(ctx, LIBSPDM_DATA_DHE_NAME_GROUP, &parameter,
                     &u16, sizeof(u16));
    u16 = SPDM_ALGORITHMS_AEAD_CIPHER_SUITE_AES_256_GCM;
    libspdm_set_data(ctx, LIBSPDM_DATA_AEAD_CIPHER_SUITE, &parameter,
                     &u16, sizeof(u16));
    u16 = SPDM_ALGORITHMS_BASE_ASYM_ALGO_TPM_ALG_ECDSA_ECC_NIST_P256;
    libspdm_set_data(ctx, LIBSPDM_DATA_REQ_BASE_ASYM_ALG, &parameter,
                     &u16, sizeof(u16));
    u16 = SPDM_ALGORITHMS_KEY_SCHEDULE_SPDM;
    libspdm_set_data(ctx, LIBSPDM_DATA_KEY_SCHEDULE, &parameter,
                     &u16, sizeof(u16));
    u8 = SPDM_ALGORITHMS_OPAQUE_DATA_FORMAT_1;
    libspdm_set_data(ctx, LIBSPDM_DATA_OTHER_PARAMS_SUPPORT, &parameter,
                     &u8, sizeof(u8));
}

void responder_thread_main(void *a, void *b, void *c)
{
    struct mock_transport *t = (struct mock_transport *)a;
    libspdm_return_t status;
    size_t scratch_size;

    ARG_UNUSED(b);
    ARG_UNUSED(c);

    printk("[responder] starting\n");

    responder_spdm_context = malloc(libspdm_get_context_size());
    if (responder_spdm_context == NULL) {
        printk("[responder] ctx alloc failed\n");
        return;
    }
    libspdm_init_context(responder_spdm_context);

    mock_transport_install(responder_spdm_context, t);
    configure_responder(responder_spdm_context);
    if (!install_responder_cert_chain(responder_spdm_context)) {
        return;
    }

    scratch_size = libspdm_get_sizeof_required_scratch_buffer(
        responder_spdm_context);
    responder_scratch = malloc(scratch_size);
    if (responder_scratch == NULL) {
        printk("[responder] scratch alloc failed (%zu)\n", scratch_size);
        return;
    }
    libspdm_set_scratch_buffer(responder_spdm_context,
                               responder_scratch, scratch_size);

    /* Hook in the application-message dispatcher: libspdm invokes
     * app_message_handler() whenever a secured message lands with
     * is_app_message set.
     */
    libspdm_register_get_response_func(responder_spdm_context,
                                       app_message_handler);

    printk("[responder] ready, scratch=%zu bytes\n", scratch_size);

    k_sem_give(&responder_ready);

    while (1) {
        status = libspdm_responder_dispatch_message(responder_spdm_context);
        if (status == LIBSPDM_STATUS_SUCCESS) {
            /* One request was received, processed, and answered. */
            printk("[responder] received a request and sent a response\n");
            continue;
        }
        if (status == LIBSPDM_STATUS_RECEIVE_FAIL) {
            /* Link closed by main() after the requester finished, or
             * the peer went quiet for MOCK_TIMEOUT_MS. Either way
             * there is nothing left to serve. */
            printk("[responder] no more requests, exiting\n");
            return;
        }
        printk("[responder] dispatch returned 0x%x\n", status);
    }
}
```

## src/spdm_loopback.h
```c
/**
 *  Copyright Notice:
 *  Copyright 2026 DMTF. All rights reserved.
 *  License: BSD 3-Clause License. For full text see link: https://github.com/DMTF/libspdm/blob/main/LICENSE.md
 **/

#ifndef SPDM_LOOPBACK_H
#define SPDM_LOOPBACK_H

#include <stdbool.h>
#include <stddef.h>
#include <stdint.h>
#include <zephyr/kernel.h>

/*
 * Buffer sizing.
 *
 * libspdm wants a contiguous send/receive buffer per side that is
 * large enough to hold the biggest SPDM message plus the transport
 * overhead. Keep it conservative for the loopback demo so we fit
 * inside Zephyr's default malloc/heap budget.
 */
#define SPDM_LOOPBACK_TRANSPORT_HEADER_SIZE   64
#define SPDM_LOOPBACK_TRANSPORT_TAIL_SIZE     64
#define SPDM_LOOPBACK_TRANSPORT_ADDITIONAL    (SPDM_LOOPBACK_TRANSPORT_HEADER_SIZE + \
                                               SPDM_LOOPBACK_TRANSPORT_TAIL_SIZE)
#define SPDM_LOOPBACK_BUFFER_SIZE             (0x1100 + SPDM_LOOPBACK_TRANSPORT_ADDITIONAL)

/*
 * Mock loopback transport.
 *
 * One mock_transport instance holds a TX channel and an RX channel.
 * The requester and responder each hold a pointer to one instance,
 * with their TX/RX swapped relative to each other.
 *
 * Send is non-blocking on a free slot, blocks if the previous message
 * has not been consumed yet. Receive blocks until data is available.
 */
struct mock_channel {
    uint8_t buf[SPDM_LOOPBACK_BUFFER_SIZE];
    size_t len;
    struct k_sem ready;   /* posted by sender after writing buf */
    struct k_sem freed;   /* posted by receiver after consuming */
    bool closed;          /* set by mock_channel_close() */
};

struct mock_transport {
    struct mock_channel *tx;   /* this side writes here */
    struct mock_channel *rx;   /* this side reads from here */
};

void mock_channel_init(struct mock_channel *ch);

/* Wake any reader blocked on this channel and make every subsequent
 * receive fail immediately, so the peer thread can wind down without
 * waiting out the receive timeout.
 */
void mock_channel_close(struct mock_channel *ch);

/* Attach t to spdm_context and register the libspdm device-IO, MCTP
 * framing and device-buffer callbacks on it.
 */
void mock_transport_install(void *spdm_context, struct mock_transport *t);

/* Posted by the responder once it can serve requests, waited on by the
 * requester before it sends GET_VERSION.
 */
extern struct k_sem responder_ready;

#define SPDM_LOOPBACK_READY_TIMEOUT K_SECONDS(10)

/* Roles. Each runs on its own Zephyr thread. */
void responder_thread_main(void *a, void *b, void *c);
void requester_thread_main(void *a, void *b, void *c);

#endif /* SPDM_LOOPBACK_H */
```
